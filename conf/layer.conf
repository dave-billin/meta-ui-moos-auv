## conf/layer.conf
```bitbake
# We have a conf directory, append to BBPATH
BBPATH .= ":${LAYERDIR}"

# We have a recipes-* directory, add to BBFILES
BBFILES += "${LAYERDIR}/recipes-*/*/*.bb \
            ${LAYERDIR}/recipes-*/*/*.bbappend"

BBFILE_COLLECTIONS += "ui-moos-auv"
BBFILE_PATTERN_ui-moos-auv = "^${LAYERDIR}/"
BBFILE_PRIORITY_ui-moos-auv = "7"

#LAYERVERSION_ui-moos-auv  = 1
#LAYERDEPENDS_ui-moos-auv  = "gumstix"
#LAYERDEPENDS_ui-moos-auv += "gumstix-extra"
```
